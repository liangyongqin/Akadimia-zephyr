## build-cmake/Kconfig/Kconfig.modules
```kconfig
menu "akadimia (/home/liangyq/workspace/Akadimia-workspace/akadimia)"
osource "/home/liangyq/workspace/Akadimia-workspace/akadimia/Kconfig"
config ZEPHYR_AKADIMIA_MODULE
	bool
	default y
endmenu
menu "cmsis (/home/liangyq/workspace/Akadimia-workspace/modules/hal/cmsis)"
osource "$(ZEPHYR_CMSIS_KCONFIG)"
config ZEPHYR_CMSIS_MODULE
	bool
	default y
endmenu
menu "cmsis-dsp (/home/liangyq/workspace/Akadimia-workspace/modules/lib/cmsis-dsp)"
osource "$(ZEPHYR_CMSIS_DSP_KCONFIG)"
config ZEPHYR_CMSIS_DSP_MODULE
	bool
	default y
endmenu
menu "cmsis-nn (/home/liangyq/workspace/Akadimia-workspace/modules/lib/cmsis-nn)"
osource "$(ZEPHYR_CMSIS_NN_KCONFIG)"
config ZEPHYR_CMSIS_NN_MODULE
	bool
	default y
endmenu
menu "fatfs (/home/liangyq/workspace/Akadimia-workspace/modules/fs/fatfs)"
osource "$(ZEPHYR_FATFS_KCONFIG)"
config ZEPHYR_FATFS_MODULE
	bool
	default y
endmenu
config ZEPHYR_HAL_STM32_MODULE
	bool
	default y

config ZEPHYR_HAL_STM32_MODULE_BLOBS
	bool
menu "lvgl (/home/liangyq/workspace/Akadimia-workspace/modules/lib/gui/lvgl)"
osource "/home/liangyq/workspace/Akadimia-workspace/modules/lib/gui/lvgl/Kconfig"
config ZEPHYR_LVGL_MODULE
	bool
	default y
endmenu
config ZEPHYR_MCUBOOT_MODULE
	bool
	default y
menu "segger (/home/liangyq/workspace/Akadimia-workspace/modules/debug/segger)"
osource "$(ZEPHYR_SEGGER_KCONFIG)"
config ZEPHYR_SEGGER_MODULE
	bool
	default y
endmenu
```

## build-cmake/Kconfig/Kconfig.shield
```kconfig
osource "/home/liangyq/workspace/Akadimia-workspace/akadimia/boards/shields/*/Kconfig.shield"
```

## build-cmake/Kconfig/arch/Kconfig
```kconfig
# Load Zephyr Arch Kconfig descriptions.
osource "/home/liangyq/workspace/Akadimia-workspace/zephyr/arch/x86/Kconfig"
osource "/home/liangyq/workspace/Akadimia-workspace/zephyr/arch/xtensa/Kconfig"
osource "/home/liangyq/workspace/Akadimia-workspace/zephyr/arch/sparc/Kconfig"
osource "/home/liangyq/workspace/Akadimia-workspace/zephyr/arch/riscv/Kconfig"
osource "/home/liangyq/workspace/Akadimia-workspace/zephyr/arch/posix/Kconfig"
osource "/home/liangyq/workspace/Akadimia-workspace/zephyr/arch/nios2/Kconfig"
osource "/home/liangyq/workspace/Akadimia-workspace/zephyr/arch/mips/Kconfig"
osource "/home/liangyq/workspace/Akadimia-workspace/zephyr/arch/arm64/Kconfig"
osource "/home/liangyq/workspace/Akadimia-workspace/zephyr/arch/arm/Kconfig"
osource "/home/liangyq/workspace/Akadimia-workspace/zephyr/arch/arc/Kconfig"
```

## build-cmake/Kconfig/boards/Kconfig.challenger_stm32f429
```kconfig
# Load board Kconfig descriptions.
osource "/home/liangyq/workspace/Akadimia-workspace/akadimia/boards/embeddedfire/challenger_stm32f429/Kconfig.challenger_stm32f429"
```

## build-cmake/Kconfig/boards/Kconfig.defconfig
```kconfig
# Load Zephyr board defconfig descriptions.
osource "/home/liangyq/workspace/Akadimia-workspace/akadimia/boards/embeddedfire/challenger_stm32f429/Kconfig.defconfig"
```

## build-cmake/Kconfig/boards/Kconfig.sysbuild
```kconfig
# Load Sysbuild board Kconfig descriptions.
osource "/home/liangyq/workspace/Akadimia-workspace/akadimia/boards/embeddedfire/challenger_stm32f429/Kconfig.sysbuild"
```

## west.yml
```yaml
manifest:
  remotes:
    - name: Akadimia-Robot
      url-base: https://github.com/Akadimia-Robot
    - name: zephyr
      url-base: https://github.com/zephyrproject-rtos
  defaults:
    remote: Akadimia-Robot

  projects:
    - name: zephyr
      repo-path: zephyr
      revision: v4.0.0
      import:
        name-allowlist:
          - cmsis
          - cmsis-dsp
          - cmsis-nn
          - hal_stm32
          - babblesim
          - mcuboot
          - fatfs
          - segger
          - lvgl
    - name: renode
      repo-path: renode
      revision: 03756cb5a3112fb94aeffef227ddec48db531cad
      path: tools/renode
```
